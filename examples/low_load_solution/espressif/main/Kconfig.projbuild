## examples/low_load_solution/espressif/main/Kconfig.projbuild
```kconfig
menu "Example Configuration"

choice AI_AGENT_MODE
    prompt "Volcano RTC/WS mode"
    default VOLC_WS_MODE

    config VOLC_WS_MODE
        bool "enable volcano ws mode"

endchoice

config VOLC_INSTANCE_ID
    string "volcano instance id"
    default ""
    depends on VOLC_WS_MODE

config VOLC_PRODUCT_KEY
    string "volcano product key"
    default ""
    depends on VOLC_WS_MODE

config VOLC_PRODUCT_SECRET
    string "product secret"
    default ""
    depends on VOLC_WS_MODE

config VOLC_DEVICE_NAME
    string "device name"
    default "volc_test"
    depends on VOLC_WS_MODE

config VOLC_BOT_ID
    string "bot id"
    default ""
    depends on VOLC_WS_MODE

menu "Develop Configuration"

choice VOLC_AUDIO_CODEC
    prompt "supported audio codec"
    default VOLC_AUDIO_G711A

    config VOLC_AUDIO_G711A
        bool "External G711A codec: 8k G711A data to SDK for upstream; 8k G711A data callback from SDK for downstream"
    
    config VOLC_AUDIO_PCM16
        bool "No audio codec: 16k pcm data to SDK for upstream; 16k pcm data callback from SDK for downstream"
endchoice

config PRINT_TASK_INFO
    bool "print task info"
    default n

endmenu

endmenu
```

## low_load_first/espressif/main/Kconfig.projbuild
```kconfig
menu "Example Configuration"

choice AI_AGENT_MODE
    prompt "Volcano RTC/WS modee"
    default VOLC_WS_MODE

    config VOLC_WS_MODE
        bool "enable volcano ws mode"

endchoice

config VOLC_INSTANCE_ID
    string "volcano instance id"
    default ""
    depends on VOLC_WS_MODE

config VOLC_PRODUCT_KEY
    string "VOLC_PRODUCT_KEY"
    default ""
    depends on VOLC_WS_MODE

config VOLC_PRODUCT_SECRET
    string "product secret"
    default ""
    depends on VOLC_WS_MODE

config VOLC_DEVICE_NAME
    string "device name"
    default "volc_test"
    depends on VOLC_WS_MODE

config VOLC_BOT_ID
    string "bot id"
    default ""
    depends on VOLC_WS_MODE

menu "Develop Configuration"

config PRINT_TASK_INFO
    bool "print task info"
    default n

endmenu

endmenu
```
