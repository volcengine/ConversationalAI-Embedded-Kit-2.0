## examples/high_quality_solution/espressif/main/Kconfig.projbuild
```kconfig
menu "Example Configuration"

choice AI_AGENT_MODE
    prompt "Volcano RTC/WS modee"
    default VOLC_RTC_MODE

    config VOLC_RTC_MODE
        bool "enable volcano rtc mode"

endchoice

choice AUDIO_CONVERSATION_MODE_SUPPORT
    prompt "Conversion Mode"
    default CONTINUOUS_CONVERSATION_MODE

config LANGUAGE_WAKEUP_MODE
    select USE_WAKENET
    select SR_WN_WN9_HILEXIN
    bool "LANGUAGE-WAKEUP-MODE"

config CONTINUOUS_CONVERSATION_MODE
    bool "CONTINUOUS-CONVERSATION-MODE"

endchoice

config VOLC_INSTANCE_ID
    string "volcano instance id"
    default ""

config VOLC_PRODUCT_KEY
    string "volcano product key"
    default ""

config VOLC_PRODUCT_SECRET
    string "product secret"
    default ""

config VOLC_DEVICE_NAME
    string "device name"
    default "volc_test"

config VOLC_BOT_ID
    string "bot id"
    default ""

config VOLC_APPID
    string "app id"
    default ""

config VOLC_IP
    string "the ip for get token"
    default ""

menu "Develop Configuration"

choice VOLC_AUDIO_CODEC
    prompt "supported audio codec"
    default VOLC_AUDIO_G711A

    config VOLC_AUDIO_G711A
        bool "External G711A codec: 8k G711A data to SDK for upstream; 8k G711A data callback from SDK for downstream"
    
    config VOLC_AUDIO_PCM16
        bool "No audio codec: 16k pcm data to SDK for upstream; 16k pcm data callback from SDK for downstream"
endchoice

config PRINT_TASK_INFO
    bool "print task info"
    default n

endmenu

endmenu
```
